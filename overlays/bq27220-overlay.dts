// BQ27220 Battery Fuel Gauge Overlay for Cardputer Zero
// NOTE: I2C address is PLACEHOLDER pending M5Stack pinout
/dts-v1/;
/plugin/;

/ {
    compatible = "brcm,bcm2837";

    fragment@0 {
        target = <&i2c1>;
        __overlay__ {
            status = "okay";
            bq27220: bq27220@55 {
                compatible = "ti,bq27220";
                reg = <0x55>;  // PLACEHOLDER I2C address
            };
        };
    };
};