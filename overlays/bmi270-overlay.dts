// BMI270 IMU Overlay for Cardputer Zero
// NOTE: I2C address is PLACEHOLDER pending M5Stack pinout
/dts-v1/;
/plugin/;

/ {
    compatible = "brcm,bcm2837";

    fragment@0 {
        target = <&i2c1>;
        __overlay__ {
            status = "okay";
            bmi270: bmi270@68 {
                compatible = "bosch,bmi270";
                reg = <0x68>;  // PLACEHOLDER I2C address
                interrupt-parent = <&gpio>;
                interrupts = <24 2>;  // PLACEHOLDER GPIO, falling edge
            };
        };
    };
};